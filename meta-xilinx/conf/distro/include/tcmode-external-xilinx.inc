## meta-xilinx/conf/distro/include/tcmode-external-xilinx.inc
```bitbake
# Copyright (C) 2011 SecretLab Technologies Ltd.
# Adrian Alonso <aalonso@secretlab.ca>
# Released under the MIT license (see packages/COPYING)
# License applies to this recipe code, not the toolchain itself
#
# Configuration to use a external toolchain built by xilinx
# git://git.xilinx.com/xldk/microblaze_v2.0.git

python __anonymous () {
    extpath = bb.data.getVar('XILINX_TOOLCHAIN', d, 1)
    if not (extpath and os.path.exists(os.path.join(extpath, "bin"))):
        bb.fatal("XILINX_TOOLCHAIN incorrect path")
}

#XILINX_TOOLCHAIN ?= "/opt/xlnx/microblaze_v2.0/microblaze-unknown-linux-gnu"
PATH =. "${XILINX_TOOLCHAIN}/bin:"

#TCLIBC = "glibc"
TARGET_VENDOR = "-unknown"
TARGET_OS = "linux-gnu"
GLIBCTARGETOS = "linux-gnu"

PREFERRED_PROVIDER_virtual/${TARGET_PREFIX}gcc = "external-xilinx-toolchain"
PREFERRED_PROVIDER_virtual/${TARGET_PREFIX}gcc-initial = "external-xilinx-toolchain"
PREFERRED_PROVIDER_virtual/${TARGET_PREFIX}binutils = "external-xilinx-toolchain"
PREFERRED_PROVIDER_virtual/${TARGET_PREFIX}libc-for-gcc = "external-xilinx-toolchain"
PREFERRED_PROVIDER_virtual/${TARGET_PREFIX}compilerlibs = "external-xilinx-toolchain"
PREFERRED_PROVIDER_virtual/libc = "external-xilinx-toolchain"
PREFERRED_PROVIDER_virtual/libintl = "external-xilinx-toolchain"
PREFERRED_PROVIDER_virtual/libiconv = "external-xilinx-toolchain"

# This are also provided in prebuilt toolchain
#PREFERRED_PROVIDER_virtual/linux-libc-headers = "external-xilinx-toolchain"
#PREFERRED_PROVIDER_linux-libc-headers = "external-xilinx-toolchain"

TOOLCHAIN_OPTIONS = " --sysroot=${XILINX_TOOLCHAIN}/${TARGET_SYS}/sys-root "
```

## meta-xilinx/conf/layer.conf
```bitbake
# We have a conf and classes directory, add to BBPATH
BBPATH := "${BBPATH}:${LAYERDIR}"

require conf/distro/include/xilinx-default-revisions.inc

# We have a packages directory, add to BBFILES
BBFILES := "${BBFILES} ${LAYERDIR}/recipes-*/*/*.bb \
	${LAYERDIR}/recipes-*/*/*.bbappend"

BBFILE_COLLECTIONS += "xilinx"
BBFILE_PATTERN_xilinx := "^${LAYERDIR}/"
BBFILE_PRIORITY_xilinx = "6"
```

## meta-xilinx/conf/machine/include/microblaze/arch-microblaze.inc
```bitbake
# Microblaze ABI interface definition
DEFAULTTUNE ?= "microblaze"

TUNEVALID[m32] = "Microblaze ELF32 standard ABI"
TUNE_CCARGS += "${@bb.utils.contains("TUNE_FEATURES", "m32", "-m32", "", d)}"
TUNE_ARCH .= "${@bb.utils.contains("TUNE_FEATURES", "m32", "microblaze", "", d)}"

TUNEVALID[fpu-soft] = "Use software FPU."
TUNE_CCARGS += "${@bb.utils.contains("TUNE_FEATURES", "fpu-soft", "-msoft-float", "", d)}"
TARGET_FPU .= "${@bb.utils.contains("TUNE_FEATURES", "fpu-soft", "soft", "", d)}"

TUNE_PKGARCH ?= "${TUNE_ARCH}"

AVAILTUNES += "microblaze"
TUNE_FEATURES_tune-microblaze ?= "m32 fpu-soft"
PACKAGE_EXTRA_ARCHS_tune-microblaze = "microblaze"
```

## meta-xilinx/conf/machine/include/tune-microblaze.inc
```bitbake
# Tune options for microblaze

require conf/machine/include/microblaze/arch-microblaze.inc

TARGET_FPU = "soft"
TUNE_CCARGS += "${@bb.utils.contains("TUNE_FEATURES", "microblaze", "-mcpu=v8.10a", "", d)}"

#MACHINEOVERRIDES .= "microblaze"
```

## meta-xilinx/conf/machine/include/tune-microblazeel.inc
```bitbake
# Tune options for microblaze endian little
DEFAULTTUNE ?= "microblazeel"

require conf/machine/include/microblaze/arch-microblaze.inc

TUNEVALID[microblazeel] = "Enable microblaze endian little optimizations"
TUNE_CCARGS += "${@bb.utils.contains("TUNE_FEATURES", "microblazeel", "-mcpu=v8.10a", "", d)}"
TUNE_PKGARCH = "${@bb.utils.contains("TUNE_FEATURES", "microblazeel", "microblazeel", "microblazeel", d)}"

TARGET_FPU = "soft"

AVAILTUNES += "microblazeel"
TUNE_FEATURES_tune-microblazeel = "m32 microblazeel"
PACKAGE_EXTRA_ARCHS_tune-microblazeel = "microblazeel"

#MACHINEOVERRIDES .= "microblaze"
```

## meta-xilinx/conf/machine/include/tune-ppc405.inc
```bitbake
DEFAULTTUNE ?= "ppc405"

require conf/machine/include/powerpc/arch-powerpc.inc

TUNEVALID[ppc405] = "Enable ppc405 specific processor optimizations"
TUNE_CCARGS += "${@bb.utils.contains("TUNE_FEATURES", "ppc405", "-mcpu=405", "", d)}"
TUNE_PKGARCH = "${@bb.utils.contains("TUNE_FEATURES", "ppc405", "ppc405", "${PPCPKGARCH}", d)}"

TARGET_FPU = "soft"
AVAILTUNES += "ppc405"
TUNE_FEATURES_tune-ppc405 = "m32 ppc405"
PACKAGE_EXTRA_ARCHS_tune-ppc405 = "ppc405"

#MACHINEOVERRIDES .= "ppc405"
```

## meta-xilinx/conf/machine/spartan6-lx9mb.conf
```bitbake
# Copyright (C) 2011, SecretLab Technologies Ltd.
# Adrian Alonso <aalonso@secretlab.ca>
# Released under the MIT license (see packages/COPYING)
#@TYPE: Machine
#@Name: Xilinx generic microblaze target support
#@DESCRIPTION: Machine configuration for Xilinx Microblaze
# Supported target: spartan6-lx9mb
#
# Xilinx EDK override hardware  definitions for xilinx-bsp
# Include in your local.conf
# XILINX_BSP_PATH = "complete path for Xilinx XPS project"

TARGET_CPU = "microblaze"
# tune for the microblaze little endian cpu
require conf/machine/include/tune-microblazeel.inc

PREFERRED_PROVIDER_virtual/kernel = "linux-xilinx"
PREFERRED_VERSION_u-boot = "uboot-xilinx"
# Add uboot to rootfs
EXTRA_IMAGEDEPENDS += "u-boot-xilinx"
XILINX_BOARD = "microblaze-generic"

KERNEL_IMAGETYPE = "simpleImage.system"

MACHINE_FEATURES = "kernel26 apm ext2 vfat ethernet"
MACHINE_EXTRA_RECOMMENDS = "kernel-modules"

UBOOT_ENTRYPOINT ?= "0xBC000000"
UBOOT_LOADADDRESS ?= "0xBC000000"
UBOOT_MACHINE ?= "microblaze-generic_config"

# Don't use tty1
USE_VT = "0"
SERIAL_CONSOLE = "115200 ttyUL0"

# Device nodes add xsa for (system ace)
IMAGE_DEVICE_TABLES = "files/device_table-minimal.txt \
                       files/device_table_add-xsa.txt"
```

## meta-xilinx/conf/machine/virtex5.conf
```bitbake
# Copyright (C) 2010, Adrian Alonso <aalonso00@gmail.com>
# Released under the MIT license (see packages/COPYING)
#@TYPE: Machine
#@Name: Xilinx Virtex5 FPGA Development Platforms
#@DESCRIPTION: Machine configuration for Xilinx Virtex5
TARGET_ARCH = "powerpc"
TARGET_CPU  = "440"
#tune for the 440 cpu
require conf/machine/include/tune-ppc440.inc

#ASSUME_PROVIDED += "virtual/kernel"
PREFERRED_PROVIDER_virtual/kernel = "linux-xilinx"
PREFERRED_VERSION_u-boot_virtex5 = "u-boot-xilinx"
# Add u-boot image
EXTRA_IMAGEDEPENDS += "u-boot-xilinx"

KERNEL_IMAGETYPE = "uImage"

MACHINE_FEATURES = "kernel26 apm ext2 vfat ethernet screen"
MACHINE_EXTRA_RECOMMENDS = "kernel-modules"

UBOOT_MACHINE ?= "ml507_config"
UBOOT_ENTRYPOINT ?= "0x00000000"
UBOOT_LOADADDRESS ?= "0x00000000"

# Xilinx EDK override hardware  definitions for xilinx-bsp
# Include in your local.conf
# XILINX_BSP_PATH = "complete path for Xilinx XPS project"
# XILINX_BOARD = "ml507"

# Don't use tty1
# USE_VT = "0"
SERIAL_CONSOLE ?= "115200 ttyUL0"

# Device nodes add xsa for (system ace)
IMAGE_DEVICE_TABLES = "files/device_table-minimal.txt \
                       files/device_table_add-xsa.txt"
```

## meta-xilinx/conf/machine/virtex5mb.conf
```bitbake
# Copyright (C) 2011, Adrian Alonso <aalonso@secretlab.ca>
# Released under the MIT license (see packages/COPYING)
#@TYPE: Machine
#@Name: Xilinx Virtex5 FPGA Development Platforms
#@DESCRIPTION: Machine configuration for Xilinx Virtex5 Microblaze

TARGET_CPU  = "microblaze"
#tune for the microblaze cpu
require conf/machine/include/tune-microblaze.inc

#ASSUME_PROVIDED += "virtual/kernel"
PREFERRED_PROVIDER_virtual/kernel = "linux-xilinx"
PREFERRED_VERSION_u-boot_virtex5mb = "u-boot-xilinx"
# Add u-boot image
EXTRA_IMAGEDEPENDS += "u-boot-xilinx"

KERNEL_IMAGETYPE = "simpleImage.system"
PREFERRED_PROVIDER_hotplug = "mdev"

MACHINE_FEATURES = "kernel26 apm ext2 vfat ethernet"
MACHINE_EXTRA_RECOMMENDS = "kernel-modules"

UBOOT_MACHINE ?= "microblaze-generic_config"
UBOOT_ENTRYPOINT ?= "0x50000000"
UBOOT_LOADADDRESS ?= "0x50000000"

# Don't use tty1
USE_VT = "0"
SERIAL_CONSOLE ?= "115200 ttyUL0"

# Device nodes add xsa for (system ace)
IMAGE_DEVICE_TABLES = "files/device_table-minimal.txt \
                       files/device_table_add-xsa.txt"
```
